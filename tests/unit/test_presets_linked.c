/*
 * Host-side test of the presets a presets-only (FDA_MODE) image links in
 * (Core/Src/presets.c): one preset from fda_preset.h, or a set from
 * preset_table.h (PRESET_TABLE).
 *
 * Built by tests/unit/run.sh once per fixture in tests/unit/fixtures/: the
 * SDK's own headers for a preset context, and expected.h, what the host
 * computes for each index. Checks that index i is the host's preset i, that
 * loading it needs that preset's own CRCs, and that every index past the set
 * is refused.
 */

#include "common.h"
#include "presets.h"
#include "trigger.h"
#include "tx7332.h"

#include "expected.h"

#include <stdio.h>
#include <string.h>

static int failures = 0;
static unsigned loads = 0;

#define CHECK(cond, ...)                                            \
	do {                                                            \
		if (!(cond)) {                                              \
			failures++;                                             \
			printf("FAIL %s:%d: ", __FILE__, __LINE__);             \
			printf(__VA_ARGS__);                                    \
			printf("\n");                                           \
		}                                                           \
	} while (0)

// What presets.c calls, recorded where the test looks at it.
TX7332 transmitters[TX_PER_MODULE];
uint32_t apod_registers[MAX_PROFILES][TX_PER_MODULE];
volatile float tx_temperature;
volatile uint32_t tx_temperature_tick;
volatile bool tx_temperature_valid;

static uint32_t reg_writes;
static uint32_t trigger_trains;

void TX7332_WriteReg(TX7332 *device, uint16_t addr, uint32_t val)
{
	(void)device; (void)addr; (void)val;
	reg_writes++;
}
void TX7332_LoadProfile(TX7332 *device) { (void)device; }
void TX7332_SetActiveDelayProfile(uint8_t profile, TX7332 *device, uint8_t chip_index)
{
	(void)profile; (void)device; (void)chip_index;
}
void TX7332_ResetApodizations(void) { }
void profile_cache_note_write(uint8_t tx_idx, uint16_t start_addr, uint16_t reg_count)
{
	(void)tx_idx; (void)start_addr; (void)reg_count;
}
bool profile_cycle_install(uint8_t profile_count, const uint8_t *order, uint8_t len)
{
	(void)profile_count; (void)order; (void)len;
	return true;
}
void auto_cycle_stop(void) { }
uint8_t get_trigger_status(void) { return TRIGGER_STATUS_READY; }
bool trigger_set_config(uint32_t frequency_hz, uint32_t pulse_width_us, uint32_t pulse_count,
                        uint32_t train_interval_us, uint32_t train_count, uint32_t mode)
{
	(void)frequency_hz; (void)pulse_width_us; (void)pulse_count; (void)train_interval_us; (void)mode;
	trigger_trains = train_count;
	return true;
}
void trigger_set_timeout_s(uint32_t timeout_s) { (void)timeout_s; }
uint32_t HAL_GetTick(void) { return 0U; }

#ifndef PRESET_TABLE
// The linker symbol the one-preset build reads its blob from (the start of
// the FDA_PRESET region): here, a copy of the same generated bytes.
#include "presets/fda_preset.h"
uint8_t _sfda_preset[PRESET_BLOB_MAX];
#endif

static bool load(uint8_t index, uint32_t duration_index, uint32_t regs_crc, uint32_t settings_crc)
{
	bool ok = presets_load(index, duration_index, regs_crc, settings_crc);
	CHECK(ok == presets_loaded(), "load(%u) returned %d but presets_loaded() is %d", index, ok,
	      presets_loaded());
	return ok;
}

// Index i is the host's preset i, and loads with each of its run lengths.
static void check_each_index(void)
{
	for (uint8_t i = 0; i < EXPECTED_COUNT; i++) {
		Preset p;
		CHECK(presets_slot_state(i) == OW_SUCCESS, "index %u does not hold a preset", i);
		if (!presets_get(i, &p)) {
			CHECK(false, "index %u does not parse", i);
			continue;
		}
		CHECK(p.id_len == strlen(expected[i].id) && memcmp(p.id, expected[i].id, p.id_len) == 0,
		      "index %u is '%.*s', expected '%s'", i, p.id_len, p.id, expected[i].id);
		CHECK(p.settings_crc == expected[i].settings_crc, "index %u settings_crc 0x%08x, expected 0x%08x",
		      i, p.settings_crc, expected[i].settings_crc);
		CHECK(p.regs_crc == expected[i].regs_crc && presets_regs_crc(&p) == expected[i].regs_crc,
		      "index %u regs_crc 0x%08x (computed 0x%08x), expected 0x%08x", i, p.regs_crc,
		      presets_regs_crc(&p), expected[i].regs_crc);
		CHECK(p.train_count_len == expected[i].train_count_len, "index %u offers %u run lengths, expected %u",
		      i, p.train_count_len, expected[i].train_count_len);

		for (uint8_t d = 0; d < p.train_count_len && d < expected[i].train_count_len; d++) {
			PresetLoaded info;
			reg_writes = 0U;
			trigger_trains = 0U;
			if (!load(i, d, expected[i].regs_crc, expected[i].settings_crc)) {
				CHECK(false, "index %u, run length %u: refused with its own CRCs", i, d);
				continue;
			}
			loads++;
			CHECK(presets_loaded_info(&info) && info.index == i && info.duration_index == d &&
			      info.train_count == expected[i].train_counts[d] &&
			      info.settings_crc == expected[i].settings_crc && info.regs_crc == expected[i].regs_crc,
			      "index %u, run length %u: OW_PRESET_LOADED reports index %u, %u trains", i, d, info.index,
			      info.train_count);
			CHECK(trigger_trains == expected[i].train_counts[d], "index %u, run length %u: trigger runs %u trains",
			      i, d, trigger_trains);
			CHECK(reg_writes > 0U, "index %u: no registers written", i);
		}
		CHECK(!load(i, expected[i].train_count_len, expected[i].regs_crc, expected[i].settings_crc),
		      "index %u: a run length it does not offer loaded", i);
	}
}

// A load needs the CRCs of the preset at that index, not of another one.
static void check_crcs_per_index(void)
{
	for (uint8_t i = 0; i < EXPECTED_COUNT; i++) {
		CHECK(!load(i, 0U, expected[i].regs_crc ^ 1U, expected[i].settings_crc),
		      "index %u loaded with a wrong regs_crc", i);
		CHECK(!load(i, 0U, expected[i].regs_crc, expected[i].settings_crc ^ 1U),
		      "index %u loaded with a wrong settings_crc", i);
		for (uint8_t j = 0; j < EXPECTED_COUNT; j++) {
			if (j == i) continue;
			CHECK(!load(i, 0U, expected[j].regs_crc, expected[j].settings_crc),
			      "index %u loaded with index %u's CRCs", i, j);
		}
	}
}

// Nothing past the set: every index from PRESET_COUNT to 255.
static unsigned check_past_the_set(void)
{
	unsigned refused = 0U;
	CHECK(presets_count() == EXPECTED_COUNT, "presets_count() is %u, expected %u", presets_count(),
	      EXPECTED_COUNT);
	for (unsigned i = EXPECTED_COUNT; i <= 255U; i++) {
		Preset p;
		CHECK(presets_slot_state((uint8_t)i) == OW_INVALID_PACKET, "index %u: slot state %u", i,
		      presets_slot_state((uint8_t)i));
		CHECK(!presets_get((uint8_t)i, &p), "index %u parses", i);
		CHECK(!load((uint8_t)i, 0U, expected[0].regs_crc, expected[0].settings_crc),
		      "index %u loaded with index 0's CRCs", i);
		refused++;
	}
	return refused;
}

int main(void)
{
#ifndef PRESET_TABLE
	memcpy(_sfda_preset, FDA_PRESET_BLOB, sizeof(FDA_PRESET_BLOB));
#endif
	check_each_index();
	check_crcs_per_index();
	unsigned refused = check_past_the_set();
	printf("%s: %u preset(s), %u load(s), %u index(es) past the set refused, %d failure(s)\n",
#ifdef PRESET_TABLE
	       "preset_table.h",
#else
	       "fda_preset.h",
#endif
	       (unsigned)EXPECTED_COUNT, loads, refused, failures);
	return failures == 0 ? 0 : 1;
}
